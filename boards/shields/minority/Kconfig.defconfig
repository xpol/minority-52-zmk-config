## boards/shields/minority/Kconfig.defconfig
```kconfig
if SHIELD_MINORITY_DONGLE

config ZMK_KEYBOARD_NAME
    default "Minority 52"
    
config ZMK_SPLIT_ROLE_CENTRAL
    default y

endif

if SHIELD_MINORITY_LEFT || SHIELD_MINORITY_RIGHT || SHIELD_MINORITY_DONGLE

config ZMK_SPLIT
    default y

endif
```

## boards/shields/minority/Kconfig.shield
```kconfig
# Copyright (c) 2022 The ZMK Contributors
# SPDX-License-Identifier: MIT

config SHIELD_MINORITY_LEFT
    def_bool $(shields_list_contains,minority_left)

config SHIELD_MINORITY_RIGHT
    def_bool $(shields_list_contains,minority_right)
```
